## boards/shields/rolio/Kconfig.defconfig
```kconfig
if SHIELD_ROLIO_LEFT

config ZMK_KEYBOARD_NAME
    default "Rolio46"

config ZMK_SPLIT_ROLE_CENTRAL
    default y

endif

if SHIELD_ROLIO_LEFT || SHIELD_ROLIO_RIGHT

config ZMK_SPLIT
    default y

endif

if SHIELD_ROLIO_DONGLE

config ZMK_KEYBOARD_NAME
    default "Rolio46"

config ZMK_SPLIT
    default y

config ZMK_SPLIT_ROLE_CENTRAL
    default y

config ZMK_SPLIT_BLE_CENTRAL_PERIPHERALS
    default 2

config BT_MAX_CONN
    default 3

config BT_MAX_PAIRED
    default 3

endif

if ZMK_BACKLIGHT

config PWM
    default y

config LED_PWM
    default y

endif # ZMK_BACKLIGHT
```

## boards/shields/rolio/Kconfig.shield
```kconfig
config SHIELD_ROLIO_LEFT
    def_bool $(shields_list_contains,rolio_left)

config SHIELD_ROLIO_RIGHT
    def_bool $(shields_list_contains,rolio_right)

config SHIELD_ROLIO_DONGLE
    def_bool $(shields_list_contains,rolio_dongle)
```
